/*
 * loragw_oled.c  –  SSD1306 128×64 OLED driver (I2C, horizontal addressing)
 *
 * All drawing operates on a local 1 KB framebuffer.
 * Call oled_refresh() to push to the display.
 *
 * Font: 5×8 bitmap for printable ASCII 0x20–0x7E (classic SSD1306 font).
 * Each byte encodes one column of 8 pixels; bit 0 = topmost pixel.
 */

#include <string.h>
#include <stdio.h>
#include "loragw_oled.h"
#include "loragw_i2c.h"

/* -------------------------------------------------------------------------- */
/* --- 5×8 ASCII FONT  (95 chars, 0x20 – 0x7E)                            --- */
/* -------------------------------------------------------------------------- */

static const uint8_t font5x8[95][5] = {
    {0x00,0x00,0x00,0x00,0x00}, /* 0x20   */
    {0x00,0x00,0x5F,0x00,0x00}, /* 0x21 ! */
    {0x00,0x07,0x00,0x07,0x00}, /* 0x22 " */
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    {0x08,0x08,0x2A,0x1C,0x08}, /* 0x7E ~ */
};

/* -------------------------------------------------------------------------- */
/* --- FRAMEBUFFER                                                          --- */
/* -------------------------------------------------------------------------- */

/*
 * Layout: framebuf[page][col]  →  page 0 = rows 0–7 (top)
 * Bit 0 of each byte = top pixel of the page, bit 7 = bottom pixel.
 */
static uint8_t framebuf[OLED_PAGES][OLED_WIDTH];

/* Transmission buffer: 0x40 control byte + 1024 data bytes */
static uint8_t tx_data[1 + OLED_PAGES * OLED_WIDTH];

/* -------------------------------------------------------------------------- */
/* --- PRIVATE HELPERS                                                      --- */
/* -------------------------------------------------------------------------- */

static int oled_cmd(uint8_t cmd)
{
    uint8_t buf[2] = { 0x00, cmd };
    return lgw_i2c_write_buf(OLED_I2C_ADDR, buf, 2);
}

/* -------------------------------------------------------------------------- */
/* --- PUBLIC API                                                           --- */
/* -------------------------------------------------------------------------- */

int oled_init(void)
{
    int err = 0;

    /* SSD1306 initialization sequence for 128×64 */
    err |= oled_cmd(0xAE);        /* display off                        */
    err |= oled_cmd(0x20);        /* memory addressing mode:            */
    err |= oled_cmd(0x00);        /*   horizontal                       */
    err |= oled_cmd(0xC8);        /* COM scan: remapped (top→bottom)    */
    err |= oled_cmd(0xA1);        /* segment re-map (col 127 → SEG0)    */
    err |= oled_cmd(0x40);        /* display start line 0               */
    err |= oled_cmd(0xA8);        /* multiplex ratio:                   */
    err |= oled_cmd(0x3F);        /*   64-1 = 63                        */
    err |= oled_cmd(0x81);        /* contrast:                          */
    err |= oled_cmd(0x7F);        /*   127                              */
    err |= oled_cmd(0xA4);        /* output follows RAM                 */
    err |= oled_cmd(0xA6);        /* normal display (not inverted)      */
    err |= oled_cmd(0xD3);        /* display offset:                    */
    err |= oled_cmd(0x00);        /*   0                                */
    err |= oled_cmd(0xD5);        /* clock divide ratio:                */
    err |= oled_cmd(0x80);        /*   default                          */
    err |= oled_cmd(0xD9);        /* pre-charge period:                 */
    err |= oled_cmd(0xF1);        /*   phase1=15, phase2=1              */
    err |= oled_cmd(0xDA);        /* COM pins config (128×64):          */
    err |= oled_cmd(0x12);        /*   alternative, disable remap       */
    err |= oled_cmd(0xDB);        /* VCOMH:                             */
    err |= oled_cmd(0x40);        /*   0.77×Vcc                         */
    err |= oled_cmd(0x8D);        /* charge pump:                       */
    err |= oled_cmd(0x14);        /*   enable                           */
    err |= oled_cmd(0xAF);        /* display ON                         */

    if (err != 0) {
        printf("ERROR: SSD1306 init failed (I2C error)\n");
        return -1;
    }

    memset(framebuf, 0, sizeof framebuf);
    oled_refresh();
    printf("INFO: SSD1306 OLED initialised\n");
    return 0;
}

void oled_clear(void)
{
    memset(framebuf, 0x00, sizeof framebuf);
    oled_refresh();
}

void oled_fill(void)
{
    memset(framebuf, 0xFF, sizeof framebuf);
    oled_refresh();
}

void oled_refresh(void)
{
    int err = 0;

    /* Set full-screen address window */
    err |= oled_cmd(0x21); err |= oled_cmd(0x00); err |= oled_cmd(0x7F);   /* col  0–127 */
    err |= oled_cmd(0x22); err |= oled_cmd(0x00); err |= oled_cmd(0x07);   /* page 0–7   */

    /* Build transmission buffer: [0x40 | framebuffer data] */
    tx_data[0] = 0x40;
    for (int p = 0; p < OLED_PAGES; p++) {
        memcpy(&tx_data[1 + p * OLED_WIDTH], framebuf[p], OLED_WIDTH);
    }
    err |= lgw_i2c_write_buf(OLED_I2C_ADDR, tx_data, sizeof tx_data);

    /* --- TEMPORARY DIAGNOSTIC --- */
    if (err != 0) {
        static uint32_t oled_err_cnt = 0;
        oled_err_cnt++;
        if (oled_err_cnt <= 10) {
            printf("[OLED] ERR: refresh failed (#%lu)\r\n",
                   (unsigned long)oled_err_cnt);
        }
    }
}

void oled_set_pixel(uint8_t x, uint8_t y, uint8_t val)
{
    if (x >= OLED_WIDTH || y >= OLED_HEIGHT) return;
    uint8_t page = y / 8;
    uint8_t bit  = y % 8;
    if (val) {
        framebuf[page][x] |=  (1u << bit);
    } else {
        framebuf[page][x] &= ~(1u << bit);
    }
}

void oled_draw_char(uint8_t col, uint8_t row, char c)
{
    if (row >= OLED_PAGES) return;
    if (col >= OLED_COLS_PER_ROW) return;

    uint8_t idx = (uint8_t)c;
    if (idx < 0x20 || idx > 0x7E) idx = 0x20;  /* replace unknown with space */

    uint8_t px = col * OLED_CHAR_W;  /* pixel column */
    const uint8_t *glyph = font5x8[idx - 0x20];

    for (int i = 0; i < 5; i++) {
        framebuf[row][px + i] = glyph[i];
    }
    framebuf[row][px + 5] = 0x00;  /* 1-pixel gap */
}

void oled_draw_string(uint8_t col, uint8_t row, const char *str)
{
    if (!str) return;
    while (*str) {
        if (col >= OLED_COLS_PER_ROW) { col = 0; row++; }
        if (row >= OLED_PAGES) break;
        oled_draw_char(col, row, *str);
        col++;
        str++;
    }
}
